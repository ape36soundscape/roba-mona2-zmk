## boards/shields/roba_compat_mona_left/Kconfig.shield
```kconfig
config SHIELD_ROBA_COMPAT_MONA_LEFT
    bool "roba_compat_mona_left (XIAO nRF52840 Central)"
    select ZMK_KEYBOARD_LAYER
```

## boards/shields/roba_compat_mona_right/Kconfig.shield
```kconfig
config SHIELD_ROBA_COMPAT_MONA_RIGHT
    bool "roba_compat_mona_right (XIAO nRF52840 Peripheral, PMW3610)"
    select ZMK_KEYBOARD_LAYER
```

## west.yml
```yaml
manifest:
  remotes:
    - name: zmkfirmware
      url-base: https://github.com/zmkfirmware
  projects:
    - name: zmk
      remote: zmkfirmware
      revision: main
      import: app/west.yml   # ← これが Zephyr ほか依存を引っ張るカギ
  self:
    path: .
```
